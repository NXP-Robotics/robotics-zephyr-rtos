## boards/nxp/mr_mcxn_t1/Kconfig.i3c_workaround
```kconfig
# Copyright 2026 NXP
# SPDX-License-Identifier: Apache-2.0

config MCXN_T1_I3C_WORKAROUND
	bool "Enable I3C workaround"
	depends on BOARD_MR_MCXN_T1
	select CONSOLE
	select UART_CONSOLE
	select UART_LINE_CTRL
	imply I2C

config USBD_CDC_ACM_LOG_LEVEL
	default 0
```

## boards/nxp/mr_mcxn_t1/board.yml
```yaml
# Copyright 2025-2026 NXP
#
# SPDX-License-Identifier: Apache-2.0

board:
  name: mr_mcxn_t1
  full_name: NXP X-MR-MCXN-T1
  vendor: nxp
  socs:
  - name: mcxn947
```

## boards/nxp/mr_mcxn_t1/mr_mcxn_t1_mcxn947_cpu0_defconfig
```kconfig
# Copyright 2026 NXP
# SPDX-License-Identifier: Apache-2.0

CONFIG_GPIO=y
CONFIG_SERIAL=y
CONFIG_CONSOLE=y
CONFIG_UART_CONSOLE=y

CONFIG_ARM_MPU=y
CONFIG_HW_STACK_PROTECTION=y
CONFIG_MAIN_STACK_SIZE=4096

CONFIG_SPI=y
CONFIG_SPI_RTIO=y
CONFIG_SENSOR=y
CONFIG_SENSOR_ASYNC_API=y

# Enable TrustZone-M
CONFIG_TRUSTED_EXECUTION_SECURE=y
```

## boards/nxp/mr_mcxn_t1/mr_mcxn_t1_mcxn947_cpu1_defconfig
```kconfig
# Copyright 2026 NXP
# SPDX-License-Identifier: Apache-2.0

CONFIG_USE_DT_CODE_PARTITION=y
```

## boards/shields/mr_mcxn_t1_f9p/Kconfig.shield
```kconfig
# Copyright 2026 NXP
#
# SPDX-License-Identifier: Apache-2.0

config SHIELD_MR_MCXN_T1_F9P
	bool "MR-MCXN-T1 F9P shield"
	help
	  Enable support for the MR-MCXN-T1 F9P shield.
	  Adds NEO-F9P-15B (GNSS) on FlexComm7 LPUART bus.
```

## boards/shields/mr_mcxn_t1_optical_flow/Kconfig.shield
```kconfig
# Copyright 2026 NXP
#
# SPDX-License-Identifier: Apache-2.0

config SHIELD_MR_MCXN_T1_OPTICAL_FLOW
	bool "MR-MCXN-T1 Optical Flow daughter board"
	help
	  Enable support for the MR-MCXN-T1 optical flow daughter board.
	  Adds AFBR-S50 (ToF), ICM42688 (IMU), ICM45686 (IMU), and
	  PAA3905 (optical flow sensor) on FlexComm3/6/7/9 SPI buses.
```

## samples/net/dhcpv4_client/boards/mr_mcxn_t1_mcxn947_cpu0.conf
```kconfig
# Copyright 2026 NXP
#
# SPDX-License-Identifier: Apache-2.0

CONFIG_SHELL=y
CONFIG_NET_SHELL=y

CONFIG_NET_ZPERF=y
CONFIG_NET_ZPERF_SERVER=y
CONFIG_ZVFS_POLL_MAX=4
```

## samples/subsys/shell/shell_module/boards/mr_mcxn_t1_mcxn947_cpu0.conf
```kconfig
# Copyright 2026 NXP
#
# SPDX-License-Identifier: Apache-2.0

CONFIG_PWM=y
CONFIG_PWM_SHELL=y
```
