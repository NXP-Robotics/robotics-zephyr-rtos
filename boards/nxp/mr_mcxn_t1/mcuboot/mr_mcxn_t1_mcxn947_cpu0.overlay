/*
 * Copyright 2026 NXP
 *
 * SPDX-License-Identifier: Apache-2.0
 */

/ {
    chosen {
        zephyr,code-partition = &boot_partition;
    };
};

/* Enable UART to pull in lpflexcomm driver (needed for MFD) */
&flexcomm1_lpuart1 {
    status = "okay";
};
